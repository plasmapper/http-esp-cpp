## test/main/Kconfig.projbuild
```kconfig
menu "Test Configuration"

  config TEST_WIFI_SSID
    string "WiFi SSID"
    default ""

  config TEST_WIFI_PASSWORD
    string "WiFi password"
    default ""

endmenu
```

## test/sdkconfig.defaults
```kconfig
CONFIG_COMPILER_CXX_RTTI=y
CONFIG_LOG_DEFAULT_LEVEL_ERROR=y
CONFIG_LOG_DEFAULT_LEVEL=1
CONFIG_LOG_MAXIMUM_LEVEL=1
CONFIG_LWIP_SO_RCVBUF=y
CONFIG_ESP32_WIFI_NVS_ENABLED=n
CONFIG_ESP_HTTPS_SERVER_ENABLE=y
CONFIG_HTTPD_MAX_REQ_HDR_LEN=1024
```
